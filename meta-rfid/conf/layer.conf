## meta-rfid/conf/layer.conf
```bitbake
BBPATH .= ":${LAYERDIR}"
BBFILES += "${LAYERDIR}/recipes-*/*/*.bb \
            ${LAYERDIR}/recipes-*/*/*.bbappend"

BBFILE_COLLECTIONS += "meta-rfid"
BBFILE_PATTERN_meta-rfid = "^${LAYERDIR}/"
BBFILE_PRIORITY_meta-rfid = "10"
LAYERSERIES_COMPAT_meta-rfid = "scarthgap"
```
